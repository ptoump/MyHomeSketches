#include <IRremote.h>
#include <MySensor.h>  
#include <MyTransportNRF24.h>
#include <MyHwATMega328.h>
#include <SPI.h>
#include <DallasTemperature.h>
#include <OneWire.h>
#include <Timer.h>
#include <avr/pgmspace.h>

#define SN "AC_n_TEMP_bsm"
#define SV "1.0"

#define ONE_WIRE_BUS 5 // Pin where dallase sensor is connected, PIN 3 Is used by IRSend !!!

#define Temp_CHILD 1           // Id of the DHT-temperature child
#define ACW2_CHILD 2           // Id of the AC Warm 2 hours child
#define ACW6_CHILD 3           // Id of the AC Warm 6 hours child

unsigned long SLEEP_TIME = 120*1000; // Sleep time between reads (in milliseconds)
OneWire oneWire(ONE_WIRE_BUS); // Setup a oneWire instance to communicate with any OneWire devices (not just Maxim/Dallas temperature ICs)
DallasTemperature sensors(&oneWire); // Pass the oneWire reference to Dallas Temperature. 
MyTransportNRF24 radio(RF24_CE_PIN, RF24_CS_PIN, RF24_PA_MAX);
MyHwATMega328 hw;
MySensor gw(radio, hw);

MyMessage tempMsg(Temp_CHILD, V_TEMP);
MyMessage acw2Msg(ACW2_CHILD, V_LIGHT);
MyMessage acw6Msg(ACW6_CHILD, V_LIGHT);

IRsend irsend;
int khz = 38;

Timer t;

boolean ac_state = false;

const unsigned AC_OFF[] PROGMEM = {3500,1750,435,435,435,1300,435,435,435,435,435,435,435,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435,1300};
const unsigned AC_WARM_AUTO[] PROGMEM = {3500,1750,435,435,435,1300,435,435,435,435,435,435,435,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435,435};
const unsigned AC_WARM_QUIET[] PROGMEM = {3500,1750,435,435,435,1300,435,435,435,435,435,435,435,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435,1300};
unsigned AC_OFF2[] = {3500,1750,435,435,435,1300,435,435,435,435,435,435,435,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435,435};

void setup() {

  irsend.sendRaw(AC_OFF, sizeof(AC_OFF)/sizeof(AC_OFF[0]), khz);
  delay(2000);
  irsend.sendRaw(AC_OFF2, sizeof(AC_OFF2)/sizeof(AC_OFF2[0]), khz);
  delay(2000);
  // Startup up the OneWire library
  sensors.begin();
  
  // requestTemperatures() will not block current thread
  sensors.setWaitForConversion(false);
  
  // Initialize library and add callback for incoming messages
  gw.begin(incomingMessage, AUTO, true);

  // Register all sensors to gw (they will be created as child devices)
  gw.present( Temp_CHILD, S_TEMP );
  gw.present( ACW2_CHILD, S_LIGHT );
  gw.present( ACW6_CHILD, S_LIGHT );
  gw.sendSketchInfo(SN, SV);

  // Schedule Temperature update
  read_temp();
  t.every(120000,read_temp);
}

void loop() {
  // MySensors Process
  gw.process();

  

  // Timer Process
  t.update();

}

void read_temp() {
  Serial.println("reading temperature from Dallas");
  sensors.requestTemperatures();  // Request Temperatures
  float temp = sensors.getTempCByIndex(0); 
  //float temp = static_cast<float>(static_cast<int>((gw.getConfig().isMetric?sensors.getTempCByIndex(0):sensors.getTempFByIndex(i)) * 10.)) / 10.;
  // Check if temp was read correctly
  if (isnan(temp)) { 
    Serial.println("Failed reading temperature from Dallas");
  } else {
  gw.send(tempMsg.set(temp, 1));
  }
}

void incomingMessage(const MyMessage &message) {

  if (message.isAck()) {
         Serial.println("This is an ack from gateway");
      }
      
  if (message.type == V_LIGHT) {
    boolean state = message.getBool();
    
    if (message.sensor == ACW2_CHILD) {
      if(state){
     schedule_auto(6600000);      
      }
      else
      {
        ac_off;
      }
      
    }
    
    if (message.sensor == ACW6_CHILD) {
       if(state){
     schedule_quiet(21000000);      
         }
      else
      {
        ac_off;
      }
      
    }
    //gw.saveState(message.sensor, state);
    }
}


void schedule_auto(int dur) {

   //ac_off;
   //gw.wait(5000);
   irsend.sendRaw(AC_WARM_AUTO, sizeof(AC_WARM_AUTO)/sizeof(AC_WARM_AUTO[0]), khz);
   t.after(dur,ac_off);
   ac_state = true;
  
}

void schedule_quiet(int dur) {

   //ac_off;
   //gw.wait(5000);
   irsend.sendRaw(AC_WARM_QUIET, sizeof(AC_WARM_QUIET)/sizeof(AC_WARM_QUIET[0]), khz);
   t.after(dur,ac_off);
   ac_state = true;
  
}

void ac_off() {
  if (ac_state) 
  {
  irsend.sendRaw(AC_OFF, sizeof(AC_OFF)/sizeof(int), khz);
  gw.wait(5000);
  irsend.sendRaw(AC_OFF, sizeof(AC_OFF)/sizeof(int), khz);
  ac_state = false;
  gw.send(acw2Msg.set(false), true);
  gw.send(acw6Msg.set(false), true);
  }
 
}


